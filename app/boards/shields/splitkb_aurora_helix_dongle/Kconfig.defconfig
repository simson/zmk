## app/boards/shields/splitkb_aurora_helix_dongle/Kconfig.defconfig
```kconfig
# Copyright (c) 2023 The ZMK Contributors
# SPDX-License-Identifier: MIT

if SHIELD_SPLITKB_AURORA_HELIX_DONGLE_CENTRAL

# Max 16 characters in keyboard name
config ZMK_KEYBOARD_NAME
    default "My Board"

config ZMK_SPLIT_ROLE_CENTRAL
    default y

config ZMK_SPLIT
    default y

# Set this to the number of peripherals your dongle will have.
# For a unibody, this would be 1. If you have left and right halves, set it to 2, etc.
config ZMK_SPLIT_BLE_CENTRAL_PERIPHERALS
    default 2

# Set this to ZMK_SPLIT_BLE_CENTRAL_PERIPHERALS + your desired number of BT profiles (default is 5)
config BT_MAX_CONN
    default 6

# Set this to the same number as BT_MAX_CONN
config BT_MAX_PAIRED
    default 6

config ZMK_DISPLAY
    default n

endif

if SHIELD_SPLITKB_AURORA_HELIX_DONGLE_LEFT || SHIELD_SPLITKB_AURORA_HELIX_DONGLE_RIGHT

config ZMK_SPLIT
    default y

config ZMK_DISPLAY
    default y

config ZMK_RGB_UNDERGLOW
    select WS2812_STRIP
    select SPI

if ZMK_DISPLAY

config SSD1306
    default y

config I2C
    default y

endif # ZMK_DISPLAY

if LVGL

config LV_Z_VDB_SIZE
    default 64

config LV_DPI_DEF
    default 148

config LV_Z_BITS_PER_PIXEL
    default 1

choice LV_COLOR_DEPTH
    default LV_COLOR_DEPTH_1
endchoice

endif # LVGL

endif # SHIELD_SPLITKB_AURORA_HELIX_LEFT || SHIELD_SPLITKB_AURORA_HELIX_RIGHT
```

## app/boards/shields/splitkb_aurora_helix_dongle/Kconfig.shield
```kconfig
# Copyright (c) 2023 The ZMK Contributors
# SPDX-License-Identifier: MIT

config SHIELD_SPLITKB_AURORA_HELIX_DONGLE_LEFT
    def_bool $(shields_list_contains,splitkb_aurora_helix_dongle_left)

config SHIELD_SPLITKB_AURORA_HELIX_DONGLE_RIGHT
    def_bool $(shields_list_contains,splitkb_aurora_helix_dongle_right)

config SHIELD_SPLITKB_AURORA_HELIX_DONGLE_CENTRAL
    def_bool $(shields_list_contains,splitkb_aurora_helix_dongle_central)
```

## app/dts/bindings/behaviors/zmk,behavior-cycle-layer.yml
```yaml
# Copyright (c) 2020 The ZMK Contributors
# SPDX-License-Identifier: MIT

description: Cycle Layer

compatible: "zmk,behavior-cycle-layer"

include: zero_param.yaml
```
