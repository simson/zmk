/*
 * Copyright (c) 2021 The ZMK Contributors
 *
 * SPDX-License-Identifier: MIT
 */

#include <dt-bindings/zmk/behaviors.h>
#include <dt-bindings/zmk/keys.h>

/ {
    behaviors {
        cycle_layer: cycle_layer {
            compatible = "zmk,behavior-cycle-layer";
            #binding-cells = <0>;
            display-name = "Layer cycle";
        };
    };
};
